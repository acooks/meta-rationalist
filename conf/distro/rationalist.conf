## conf/distro/rationalist.conf
```bitbake
require conf/distro/poky.conf

DISTRO = "rationalist"
DISTRO_NAME = "Rationalist OS)"
DISTRO_VERSION = "0.0.2"
DISTRO_CODENAME = "dreamer"
SDK_VENDOR = "-pokysdk"
SDK_VERSION := "${@'${DISTRO_VERSION}'}"

MAINTAINER = "Andrew Cooks <acooks@rationali.st>"

TARGET_VENDOR = "-poky"

LOCALCONF_VERSION = "1"
LAYER_CONF_VERSION ?= "7"


# Override these in poky based distros
POKY_DEFAULT_DISTRO_FEATURES = "largefile ptest "
POKY_DEFAULT_EXTRA_RDEPENDS = "packagegroup-core-boot"
POKY_DEFAULT_EXTRA_RRECOMMENDS = "kernel-module-af-packet"

DISTRO_FEATURES = "systemd ${DISTRO_FEATURES_DEFAULT} ${DISTRO_FEATURES_LIBC} ${POKY_DEFAULT_DISTRO_FEATURES}"
VIRTUAL-RUNTIME_init_manager = "systemd"
DISTRO_FEATURES_BACKFILL_CONSIDERED = "sysvinit"

SDK_NAME = "${DISTRO}-${TCLIBC}-${SDK_ARCH}-${IMAGE_BASENAME}-${TUNE_PKGARCH}"
SDKPATH = "/opt/${DISTRO}/${SDK_VERSION}"

EXTRAOPKGCONFIG = "poky-feed-config-opkg"

DISTRO_EXTRA_RDEPENDS += " ${POKY_DEFAULT_EXTRA_RDEPENDS}"
DISTRO_EXTRA_RRECOMMENDS += " ${POKY_DEFAULT_EXTRA_RRECOMMENDS}"

POKYQEMUDEPS = "${@base_contains("INCOMPATIBLE_LICENSE", "GPLv3", "", "qemu-config",d)}"
DISTRO_EXTRA_RDEPENDS_append_qemuarm = " ${POKYQEMUDEPS}"
DISTRO_EXTRA_RDEPENDS_append_qemumips = " ${POKYQEMUDEPS}"
DISTRO_EXTRA_RDEPENDS_append_qemuppc = " ${POKYQEMUDEPS}"
DISTRO_EXTRA_RDEPENDS_append_qemux86 = " ${POKYQEMUDEPS}"
DISTRO_EXTRA_RDEPENDS_append_qemux86-64 = " ${POKYQEMUDEPS}"

TCLIBCAPPEND = ""

QEMU_TARGETS ?= "arm i386 mips mipsel ppc x86_64"
# Other QEMU_TARGETS "mips64 mips64el sh4"

PREMIRRORS ??= "\
bzr://.*/.*   http://downloads.yoctoproject.org/mirror/sources/ \n \
cvs://.*/.*   http://downloads.yoctoproject.org/mirror/sources/ \n \
git://.*/.*   http://downloads.yoctoproject.org/mirror/sources/ \n \
hg://.*/.*    http://downloads.yoctoproject.org/mirror/sources/ \n \
osc://.*/.*   http://downloads.yoctoproject.org/mirror/sources/ \n \
p4://.*/.*    http://downloads.yoctoproject.org/mirror/sources/ \n \
svk://.*/.*   http://downloads.yoctoproject.org/mirror/sources/ \n \
svn://.*/.*   http://downloads.yoctoproject.org/mirror/sources/ \n"

MIRRORS =+ "\
ftp://.*/.*      http://downloads.yoctoproject.org/mirror/sources/ \n \
http://.*/.*     http://downloads.yoctoproject.org/mirror/sources/ \n \
https://.*/.*    http://downloads.yoctoproject.org/mirror/sources/ \n"

# The CONNECTIVITY_CHECK_URI's are used to test whether we can succesfully
# fetch from the network (and warn you if not). To disable the test set
# the variable to be empty.
# Git example url: git://git.yoctoproject.org/yocto-firewall-test;protocol=git;rev=HEAD

CONNECTIVITY_CHECK_URIS ?= " \
             https://eula-downloads.yoctoproject.org/index.php \
             http://bugzilla.yoctoproject.org/report.cgi"

SANITY_TESTED_DISTROS ?= " \
            Fedora-20 \n \
            "

# Default hash policy for distro
BB_SIGNATURE_HANDLER ?= 'OEBasicHash'
#
# OELAYOUT_ABI allows us to notify users when the format of TMPDIR changes in 
# an incompatible way. Such changes should usually be detailed in the commit
# that breaks the format and have been previously discussed on the mailing list 
# with general agreement from the core team.
#
OELAYOUT_ABI = "8"

# add poky sanity bbclass
INHERIT += "poky-sanity"

# QA check settings - a little stricter than the OE-Core defaults
WARN_QA = "textrel files-invalid incompatible-license xorg-driver-abi libdir \
           unknown-configure-option"
ERROR_QA = "dev-so debug-deps dev-deps debug-files arch pkgconfig la perms \
            useless-rpaths rpaths staticdev ldflags pkgvarcheck already-stripped \
            compile-host-path dep-cmp installed-vs-shipped install-host-path \
            packages-list perm-config perm-line perm-link pkgv-undefined \
            pn-overrides split-strip var-undefined version-going-backwards"
```

## conf/layer.conf
```bitbake
# We have a conf and classes directory, add to BBPATH
BBPATH .= ":${LAYERDIR}"

# We have recipes-* directories, add to BBFILES
BBFILES += "${LAYERDIR}/recipes-*/*/*.bb \
	${LAYERDIR}/recipes-*/*/*.bbappend"

BBFILE_COLLECTIONS += "rationalist"
BBFILE_PATTERN_rationalist = "^${LAYERDIR}/"
BBFILE_PRIORITY_rationalist = "6"
```

## conf/machine/include/tune-btver1.inc
```bitbake
# Settings for the GCC(1) cpu-type "btver1":
#
#     AMD Bobcat CPU with 64-bit extensions, MMX, SSE, SSE2, SSE3, SSSE3,
#     SSE4A, CX16 and ABM instruction set support.
#
# This tune is recommended for AMD Bobcat CPUs.
#
DEFAULTTUNE ?= "btver1-64"

# Pull in the previous tune in to pull in PACKAGE_EXTRA_ARCHS
require conf/machine/include/tune-core2.inc

# Extra tune features
TUNEVALID[btver1] = "Enable AMD Bobcat specific processor optimizations"
TUNE_CCARGS .= "${@bb.utils.contains("TUNE_FEATURES", "btver1", " -march=btver1 -mtune=btver1 -mfpmath=sse -msse4a -msse -msse2", "", d)}"

# Extra tune selections
AVAILTUNES += "btver1-32"
TUNE_FEATURES_tune-btver1-32 = "${TUNE_FEATURES_tune-x86} btver1"
BASE_LIB_tune-btver1-32 = "lib"
TUNE_PKGARCH_tune-btver1-32 = "btver1-32"
PACKAGE_EXTRA_ARCHS_tune-btver1-32 = "${PACKAGE_EXTRA_ARCHS_tune-core2-32} btver1-32"

AVAILTUNES += "btver1-64"
TUNE_FEATURES_tune-btver1-64 = "${TUNE_FEATURES_tune-x86-64} btver1"
BASE_LIB_tune-btver1-64 = "lib64"
TUNE_PKGARCH_tune-btver1-64 = "btver1-64"
PACKAGE_EXTRA_ARCHS_tune-btver1-64 = "${PACKAGE_EXTRA_ARCHS_tune-core2-64} btver1-64"

AVAILTUNES += "btver1-64-x32"
TUNE_FEATURES_tune-btver1-64-x32 = "${TUNE_FEATURES_tune-x86-64-x32} btver1"
BASE_LIB_tune-btver1-64-x32 = "libx32"
TUNE_PKGARCH_tune-btver1-64-x32 = "btver1-64-x32"
PACKAGE_EXTRA_ARCHS_tune-btver1-64-x32 = "${PACKAGE_EXTRA_ARCHS_tune-core2-64-x32} btver1-64-x32"
```

## conf/machine/include/tune-btver2.inc
```bitbake
# Settings for the GCC(1) cpu-type "btver2":
#
#     AMD Jaguar CPU with 64-bit extensions, MMX, SSE, SSE2, SSE3, SSSE3,
#     SSE4A, SSE4, SSE4.1, SSE4.2, AES, AVX, BMI1, F16C, CX16 and ABM
#     instruction set support.
#
# This tune is recommended for AMD Jaguar CPUs.
#
DEFAULTTUNE ?= "btver2-64"

# Pull in the previous tune in to pull in PACKAGE_EXTRA_ARCHS
require conf/machine/include/tune-core2.inc

# Extra tune features
TUNEVALID[btver2] = "Enable AMD Bobcat specific processor optimizations"
TUNE_CCARGS .= "${@bb.utils.contains("TUNE_FEATURES", "btver2", " -march=btver2 -mtune=btver2 -mfpmath=sse -msse4a -msse4 -msse4.1 -msse4.2 -msse -msse2", "", d)}"

# Extra tune selections
AVAILTUNES += "btver2-32"
TUNE_FEATURES_tune-btver2-32 = "${TUNE_FEATURES_tune-x86} btver2"
BASE_LIB_tune-btver2-32 = "lib"
TUNE_PKGARCH_tune-btver2-32 = "btver2-32"
PACKAGE_EXTRA_ARCHS_tune-btver2-32 = "${PACKAGE_EXTRA_ARCHS_tune-core2-32} btver2-32"

AVAILTUNES += "btver2-64"
TUNE_FEATURES_tune-btver2-64 = "${TUNE_FEATURES_tune-x86-64} btver2"
BASE_LIB_tune-btver2-64 = "lib64"
TUNE_PKGARCH_tune-btver2-64 = "btver2-64"
PACKAGE_EXTRA_ARCHS_tune-btver2-64 = "${PACKAGE_EXTRA_ARCHS_tune-core2-64} btver2-64"

AVAILTUNES += "btver2-64-x32"
TUNE_FEATURES_tune-btver2-64-x32 = "${TUNE_FEATURES_tune-x86-64-x32} btver2"
BASE_LIB_tune-btver2-64-x32 = "libx32"
TUNE_PKGARCH_tune-btver2-64-x32 = "btver2-64-x32"
PACKAGE_EXTRA_ARCHS_tune-btver2-64-x32 = "${PACKAGE_EXTRA_ARCHS_tune-core2-64-x32} btver2-64-x32"
```

## conf/machine/mousetrap_hw.conf
```bitbake
#@TYPE: Machine
#@NAME: Mousetrap

#@DESCRIPTION: Machine configuration for Rationalist MouseTrap hardware.

DEFAULTTUNE = "core2-32"
require conf/machine/include/tune-core2.inc
require conf/machine/include/genericx86-common.inc

PREFERRED_PROVIDER_virtual/kernel = "linux-rationalist"
PREFERRED_VERSION_linux-yocto = "3.18%"
PREFERRED_VERSION_linux-rationalist = "4.2%"

MACHINE_ESSENTIAL_EXTRA_RDEPENDS += "linux-firmware-rtl8168"

SERIAL_CONSOLES = "115200;ttyS0"

#APPEND += " 
```

## conf/machine/pcengines-apu2.conf
```bitbake
#@TYPE: Machine
#@NAME: PC Engines APU2

#@DESCRIPTION: Machine configuration for BufferUpr.

DEFAULTTUNE = "btver2-32"
require conf/machine/include/tune-btver2.inc

require conf/machine/include/genericx86-common.inc

PREFERRED_PROVIDER_virtual/kernel = "linux-rationalist"
PREFERRED_VERSION_linux-rationalist = "4.4%"

SERIAL_CONSOLES = "115200;ttyS0"

#APPEND += " 
```
